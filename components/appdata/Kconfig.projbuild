## components/appdata/Kconfig.projbuild
```kconfig
menu "Data Storage"

    config MAX_OFFLINE_READINGS
        int "The maximum number of offline readings hygienie will take before sending it to network server."
        default 10
        depends on IDF_TARGET_ESP32 || IDF_TARGET_ESP32S2 || IDF_TARGET_ESP32S3
        help
            This is the number of offline readings the hygienie will store before sending it to network server. After data is sent, the buffer will be cleared.

    config DEVICE_NAME
        string "The name of the device."
        default "Nursing Station"
        depends on IDF_TARGET_ESP32 || IDF_TARGET_ESP32S2 || IDF_TARGET_ESP32S3
        help
            This is the name of the device.

    config DEVICE_ID
        string "The id of the device. This should be related to the device's location."
        default "Hospital Foyer"
        depends on IDF_TARGET_ESP32 || IDF_TARGET_ESP32S2 || IDF_TARGET_ESP32S3
        help
            This is the id of the device that pertains to the location in the facility.
endmenu
```

## components/appgraphics/Kconfig.projbuild
```kconfig
menu "Delay between Animation"

  config  GRAPHICS_DELAY_MS
      int "Delay between animations"
      range 10 3600000
      default 1000
      help
          Defines the Delay between different animations
endmenu
```

## components/appmqtt/Kconfig.projbuild
```kconfig
menu "MQTT"

    config MQTT_URL
        string "Application Server Web Address"
        default "mqtt://hygienieproject.xyz"
        depends on IDF_TARGET_ESP32 || IDF_TARGET_ESP32S2 || IDF_TARGET_ESP32S3
        help
            This is the web address to send the sanitizer data to. Be sure to include mqtt://
            in front of it.

    config MQTT_IP_ADDRESS_WITH_PORT
        string "Application Server ip address"
        default "mqtt://3.19.24.164:1883"
        depends on IDF_TARGET_ESP32 || IDF_TARGET_ESP32S2 || IDF_TARGET_ESP32S3
        help
           This is ip address and port to send the sanitizer data to. Be sure to use the format "mqtt://<IP_ADDRESS>:<PORT>"

    config MQTT_CLIENT_ID
        string "Client ID of sensor"
        default arrgh
        depends on !IDF_TARGET_ESP32C3
        help
            The client ID of the sensor.

    config MQTT_USERNAME
        string "Username of Device"
        default username
        help
            The client ID of the sensor.

    config MQTT_PASSWORD
        string "Password of Device"
        default password
        help
            The password of the sensor.
endmenu
```
